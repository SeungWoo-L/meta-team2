## conf/bblayers.conf
```bitbake
# POKY_BBLAYERS_CONF_VERSION is increased each time build/conf/bblayers.conf
# changes incompatibly
POKY_BBLAYERS_CONF_VERSION = "2"

BBPATH = "${TOPDIR}"
BBFILES ?= ""

BBLAYERS ?= " \
  /home/seame02/poky_src/poky/meta \
  /home/seame02/poky_src/poky/meta-poky \
  /home/seame02/poky_src/poky/meta-yocto-bsp \
  /home/seame02/poky_src/poky/meta-raspberrypi \
  /home/seame02/poky_src/poky/meta-clang \
  /home/seame02/poky_src/poky/meta-flutter \
  /home/seame02/poky_src/poky/meta-openembedded/meta-oe \
  /home/seame02/poky_src/poky/meta-openembedded/meta-python \
  /home/seame02/poky_src/poky/meta-openembedded/meta-multimedia \
  /home/seame02/poky_src/poky/meta-openembedded/meta-networking \
  /home/seame02/poky_src/poky/meta-team2 \
  "
```

## conf/layer.conf
```bitbake
# We have a conf and classes directory, add to BBPATH
BBPATH .= ":${LAYERDIR}"

# We have recipes-* directories, add to BBFILES
BBFILES += "${LAYERDIR}/recipes-*/*/*.bb \
            ${LAYERDIR}/recipes-*/*/*.bbappend \
            ${LAYERDIR}/recipes-*/*/*/*.bb \
"

BBFILE_COLLECTIONS += "team2"
BBFILE_PATTERN_team2 = "^${LAYERDIR}/"
BBFILE_PRIORITY_team2 = "13"

LAYERDEPENDS_meta-env = "core"
LAYERSERIES_COMPAT_team2= "kirkstone"

LICENSE_FLAGS_ACCEPTED += "commercial"
```
